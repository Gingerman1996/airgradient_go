## sdkconfig.defaults
```kconfig
# AirGradient GO - ESP32-C5-MINI-1 SDK Configuration
# Target: 4 MB Flash, ESP-IDF v5.5.1

# Chip Configuration
CONFIG_IDF_TARGET="esp32c5"
CONFIG_IDF_TARGET_ESP32C5=y

# Flash Size Configuration (4 MB)
CONFIG_ESPTOOLPY_FLASHSIZE_4MB=y
CONFIG_ESPTOOLPY_FLASHFREQ_80M=y
CONFIG_ESPTOOLPY_FLASHMODE_DIO=y

# Partition Configuration
CONFIG_PARTITION_TABLE_CUSTOM=y
CONFIG_PARTITION_TABLE_CUSTOM_FILENAME=".config/partitions.csv"

# Compiler Optimizations for Size (critical for 4 MB constraint)
CONFIG_COMPILER_OPTIMIZATION_SIZE=y
CONFIG_COMPILER_OPTIMIZATION_ASSERTIONS_SILENT=y

# OTA Configuration
CONFIG_APP_ROLLBACK_ENABLE=y
CONFIG_OTA_ALLOW_HTTP=y

# Logging
CONFIG_LOG_DEFAULT_LEVEL=3
CONFIG_LOG_DEFAULT_LEVEL_INFO=y

# FreeRTOS Configuration
CONFIG_FREERTOS_HZ=100
CONFIG_FREERTOS_THREAD_LOCAL_STORAGE_POINTERS=8
CONFIG_FREERTOS_SUPPORT_STATIC_ALLOCATION=y

# I2C Configuration
CONFIG_I2C_ENABLE_DEBUG_LOG=n

# LVGL Configuration (UI Display)
CONFIG_LV_FONT_MONTSERRAT_16=y
CONFIG_LV_FONT_MONTSERRAT_20=y
CONFIG_LV_FONT_MONTSERRAT_24=y

# Debug/Release
CONFIG_APP_REPRODUCIBLE_BUILD=y
CONFIG_APP_OPTIMIZE_FOR_LAUNCHING_SPEED=n

# HTTP Client (for OTA and sensor data upload)
CONFIG_ESP_HTTP_CLIENT_ENABLE_HTTPS=y
CONFIG_ESP_HTTP_CLIENT_ENABLE_DIGEST_AUTH=y
```
